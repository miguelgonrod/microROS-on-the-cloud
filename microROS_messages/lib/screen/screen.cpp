#include "screen.h"


int buttonState = 0;
int lastButtonState = 0;

int cpuChoice = 0;

unsigned long lastDebounceTime = 0;
unsigned long debounceDelay = 50;

TwoWire I2Cbus = TwoWire(0);


Adafruit_SSD1306 display(SCREEN_WIDTH, SCREEN_HEIGHT, &I2Cbus, -1);


const unsigned char epd_bitmap_piedra[] PROGMEM = {
	0x00, 0x00, 0x00, 0x00, 0x00, 0x00, 0x00, 0x00, 0x00, 0x00, 0x00, 0x00, 0x00, 0x00, 0x00, 0x00,
	0x00, 0x00, 0x00, 0x00, 0x00, 0x00, 0x00, 0x00, 0x00, 0x00, 0x00, 0x00, 0x00, 0x00, 0x00, 0x00,
	0x00, 0x00, 0x00, 0x00, 0x00, 0x00, 0x00, 0x03, 0xce, 0x00, 0x00, 0x00, 0x00, 0x00, 0x00, 0x00,
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	0x00, 0x00, 0x00, 0x00, 0x00, 0x00, 0x00, 0x00, 0x00, 0x00, 0x00, 0x00, 0x00, 0x00, 0x00, 0x00};

const unsigned char epd_bitmap_tijera[] PROGMEM = {
	0x00, 0x00, 0x00, 0x00, 0x00, 0x00, 0x00, 0x00, 0x00, 0x00, 0x00, 0x00, 0x00, 0x00, 0x00, 0x00,
	0x00, 0x00, 0x00, 0x00, 0x00, 0x00, 0x00, 0x00, 0x00, 0x00, 0x00, 0x00, 0x00, 0x00, 0x00, 0x00,
	0x00, 0x00, 0x00, 0x00, 0x00, 0x00, 0x00, 0x00, 0x00, 0x00, 0x00, 0x00, 0x00, 0x00, 0x00, 0x00,
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	0x00, 0x00, 0x00, 0x00, 0x00, 0x00, 0x00, 0x00, 0x00, 0x00, 0x00, 0x00, 0x00, 0x00, 0x00, 0x00};

const unsigned char epd_bitmap_papel[] PROGMEM = {
	0x00, 0x00, 0x00, 0x00, 0x00, 0x00, 0x00, 0x00, 0x00, 0x00, 0x00, 0x00, 0x00, 0x00, 0x00, 0x00,
	0x00, 0x00, 0x00, 0x00, 0x00, 0x00, 0x00, 0x03, 0xe0, 0x00, 0x00, 0x00, 0x00, 0x00, 0x00, 0x00,
	0x00, 0x00, 0x00, 0x00, 0x00, 0x00, 0x00, 0x07, 0xf0, 0x00, 0x00, 0x00, 0x00, 0x00, 0x00, 0x00,
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	0x00, 0x00, 0x00, 0x00, 0x00, 0x00, 0x00, 0x00, 0x00, 0x00, 0x00, 0x00, 0x00, 0x00, 0x00, 0x00};


const int epd_bitmap_allArray_LEN = 3;

const unsigned char *epd_bitmap_allArray[3] = {
	epd_bitmap_piedra,
	epd_bitmap_papel,
	epd_bitmap_tijera
};

void display_setup()
{

	I2Cbus.begin(I2C_SDA, I2C_SCL, 100000);

	Serial.begin(115200);


	if (!display.begin(SSD1306_SWITCHCAPVCC, 0x3C))
	{
		Serial.println(F("No se encontró la pantalla SSD1306"));
		for (;;)
			;
	}

	buttonState = 0;
	lastButtonState = 0;

	pinMode(buttonPin, OUTPUT);

	screen();
}

void display_game()
{

	int reading = digitalRead(buttonPin);

	if (reading != lastButtonState)
	{

		lastDebounceTime = millis();
	}

	if ((millis() - lastDebounceTime) > debounceDelay)
	{
		if (reading != buttonState)
		{
			buttonState = reading;
			Serial.println(buttonState);
			if (buttonState == LOW)
			{

				display.clearDisplay();
				display.drawBitmap(0, 0, epd_bitmap_allArray[0], 128, 32, WHITE);
				display.display();

				delay(1500);

				display.clearDisplay();
				display.drawBitmap(0, 0, epd_bitmap_allArray[1], 128, 32, WHITE);
				display.display();

				delay(1500);

				display.clearDisplay();
				display.drawBitmap(0, 0, epd_bitmap_allArray[2], 128, 32, WHITE);
				display.display();

				delay(1500);

				cpuChoice = random(0, 3);

				display_message(3);
				
				delay(1000);

				if (cpuChoice == 0){
					display.clearDisplay();
					display.drawBitmap(0, 0, epd_bitmap_allArray[0], 128, 32, WHITE);
					display.display();
				}
				else if (cpuChoice == 1){
					display.clearDisplay();
					display.drawBitmap(0, 0, epd_bitmap_allArray[1], 128, 32, WHITE);
					display.display();
				}
				else{
					display.clearDisplay();
					display.drawBitmap(0, 0, epd_bitmap_allArray[2], 128, 32, WHITE);
					display.display();
				}

				delay(1000);

				if(xSemaphoreTake(playerOptionMutex, portMAX_DELAY)){
					if ((playerOption == 0 && cpuChoice == 0) || (playerOption == 1 && cpuChoice == 1) || (playerOption == 2 && cpuChoice == 2))
					{
						display_message(0);
					}
					else if ((playerOption == 0 && cpuChoice == 2) || (playerOption == 1 && cpuChoice == 0) || (playerOption == 2 && cpuChoice == 1))
					{
						display_message(1);
					}
					else
					{
						display_message(2);
					}

					xSemaphoreGive(playerOptionMutex);
				}

				delay(1500);

				screen();
			}
		}
	}


	lastButtonState = reading;
}

void screen()
{
	display.clearDisplay();
	display.setTextSize(1);
	display.setTextColor(SSD1306_WHITE);
	display.setCursor(0, 10);
	display.println("Oprime el boton");
	display.setCursor(0, 20);
	display.println("para iniciar");
	display.display();
}

void display_message(int resultado)
{
	display.clearDisplay();
	display.setTextSize(2);

	String mensaje;

	if (resultado == 1)
	{
		mensaje = "Has ganado";
	}
	else if (resultado == 0)
	{
		mensaje = "Has empatado";
	}
	else if (resultado == 3){
		mensaje = "Yo elijo";
	}
	else
	{
		mensaje = "Has perdido";
	}


	int16_t x1, y1;
	uint16_t w, h;
	display.getTextBounds(mensaje, 0, 0, &x1, &y1, &w, &h);
	int16_t x = (SCREEN_WIDTH - w) / 2;
	int16_t y = (SCREEN_HEIGHT - h) / 2;


	display.setCursor(x, y);
	display.print(mensaje);
	display.display();
}

void display_main(void* pvParameters)
{
	while (true)
	{
		display_game();
		vTaskDelay(50 / portTICK_PERIOD_MS);
	}
}